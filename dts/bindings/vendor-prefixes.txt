## modules/ble_peripheral/Kconfig
```kconfig
# Copyright (C) 2026 Georgi Danovski
#
# This program is free software: you can redistribute it and/or modify
# it under the terms of the GNU General Public License as published by
# the Free Software Foundation, either version 3 of the License, or
# (at your option) any later version.
#
# This program is distributed in the hope that it will be useful,
# but WITHOUT ANY WARRANTY; without even the implied warranty of
# MERCHANTABILITY or FITNESS FOR A PARTICULAR PURPOSE.  See the
# GNU General Public License for more details.
#
# You should have received a copy of the GNU General Public License
# along with this program.  If not, see <https://www.gnu.org/licenses/>.

menu "BLE peripheral module"

config BLE_PERIPHERAL_MODULE
	bool "Enable BLE peripheral module"
	default y
	depends on BT && BT_PERIPHERAL && BT_SMP

config BLE_PERIPHERAL_MODULE_LOG_LEVEL
	int "BLE peripheral module log level"
	range 0 4
	default 3
	depends on BLE_PERIPHERAL_MODULE && LOG

endmenu
```

## modules/led/Kconfig
```kconfig
# Copyright (C) 2026 Georgi Danovski
#
# This program is free software: you can redistribute it and/or modify
# it under the terms of the GNU General Public License as published by
# the Free Software Foundation, either version 3 of the License, or
# (at your option) any later version.
#
# This program is distributed in the hope that it will be useful,
# but WITHOUT ANY WARRANTY; without even the implied warranty of
# MERCHANTABILITY or FITNESS FOR A PARTICULAR PURPOSE.  See the
# GNU General Public License for more details.
#
# You should have received a copy of the GNU General Public License
# along with this program.  If not, see <https://www.gnu.org/licenses/>.

menuconfig LED_MODULE
	bool "LED module"
	depends on GPIO
	help
	  Enable onboard LED helper API.

if LED_MODULE

config LED_MODULE_LOG_LEVEL
	int "LED module log level"
	range 0 4
	default 3
	depends on LOG
	help
	  Log level for the LED module.
	  0: off, 1: error, 2: warning, 3: info, 4: debug.

endif
```

## modules/leg/Kconfig
```kconfig
# Copyright (C) 2026 Georgi Danovski
#
# This program is free software: you can redistribute it and/or modify
# it under the terms of the GNU General Public License as published by
# the Free Software Foundation, either version 3 of the License, or
# (at your option) any later version.
#
# This program is distributed in the hope that it will be useful,
# but WITHOUT ANY WARRANTY; without even the implied warranty of
# MERCHANTABILITY or FITNESS FOR A PARTICULAR PURPOSE.  See the
# GNU General Public License for more details.
#
# You should have received a copy of the GNU General Public License
# along with this program.  If not, see <https://www.gnu.org/licenses/>.

menu "LEG module"

config LEG_MODULE
	bool "Enable LEG module"
	default y
	depends on PWM
	help
	  Enable the LEG driver module.

if LEG_MODULE

config LEG_MODULE_INIT_PRIORITY
	int "LEG device init priority"
	range 0 999
	default KERNEL_INIT_PRIORITY_DEVICE
	help
	  Initialization priority for danovski,leg devices at POST_KERNEL level.

endif

endmenu
```

## modules/leg/dts/bindings/mfd/danovski,leg.yaml
```yaml
# Copyright (C) 2026 Georgi Danovski
#
# This program is free software: you can redistribute it and/or modify
# it under the terms of the GNU General Public License as published by
# the Free Software Foundation, either version 3 of the License, or
# (at your option) any later version.
#
# This program is distributed in the hope that it will be useful,
# but WITHOUT ANY WARRANTY; without even the implied warranty of
# MERCHANTABILITY or FITNESS FOR A PARTICULAR PURPOSE.  See the
# GNU General Public License for more details.
#
# You should have received a copy of the GNU General Public License
# along with this program.  If not, see <https://www.gnu.org/licenses/>.

description: LEG node with integrated coxa and femur PWM configuration
compatible: "danovski,leg"

include: base.yaml

properties:
  pwms:
    type: phandle-array
    required: true
    description: |
      PWM specifiers for leg joints.
      Index 0 is coxa and index 1 is femur.

  pwm-names:
    type: string-array
    required: true
    description: PWM names, expected order is "coxa", "femur".

  coxa-min-pulse:
    type: int
    required: true
    description: Minimum coxa pulse width in nanoseconds.

  coxa-max-pulse:
    type: int
    required: true
    description: Maximum coxa pulse width in nanoseconds.

  femur-min-pulse:
    type: int
    required: true
    description: Minimum femur pulse width in nanoseconds.

  femur-max-pulse:
    type: int
    required: true
    description: Maximum femur pulse width in nanoseconds.
```

## modules/measurements/Kconfig
```kconfig
# Copyright (C) 2026 Georgi Danovski
#
# This program is free software: you can redistribute it and/or modify
# it under the terms of the GNU General Public License as published by
# the Free Software Foundation, either version 3 of the License, or
# (at your option) any later version.
#
# This program is distributed in the hope that it will be useful,
# but WITHOUT ANY WARRANTY; without even the implied warranty of
# MERCHANTABILITY or FITNESS FOR A PARTICULAR PURPOSE.  See the
# GNU General Public License for more details.
#
# You should have received a copy of the GNU General Public License
# along with this program.  If not, see <https://www.gnu.org/licenses/>.

menu "Measurements module"

config MEASUREMENTS_MODULE
	bool "Enable measurements module"
	default y
	depends on ADC && SENSOR

config MEASUREMENTS_MODULE_INIT_PRIORITY
	int "Measurements device init priority"
	range 0 999
	default 92
	depends on MEASUREMENTS_MODULE

config MEASUREMENTS_MODULE_LOG_LEVEL
	int "Measurements module log level"
	range 0 4
	default 3
	depends on MEASUREMENTS_MODULE && LOG

endmenu
```

## modules/measurements/dts/bindings/sensor/danovski,measurements.yaml
```yaml
# Copyright (C) 2026 Georgi Danovski
#
# This program is free software: you can redistribute it and/or modify
# it under the terms of the GNU General Public License as published by
# the Free Software Foundation, either version 3 of the License, or
# (at your option) any later version.
#
# This program is distributed in the hope that it will be useful,
# but WITHOUT ANY WARRANTY; without even the implied warranty of
# MERCHANTABILITY or FITNESS FOR A PARTICULAR PURPOSE.  See the
# GNU General Public License for more details.
#
# You should have received a copy of the GNU General Public License
# along with this program.  If not, see <https://www.gnu.org/licenses/>.

description: Measurements sensor backed by one ADC channel
compatible: "danovski,measurements"

include: sensor-device.yaml

properties:
  io-channels:
    type: phandle-array
    required: true

  resolution:
    type: int
    description: ADC sequence resolution in bits.
    default: 12

  oversampling:
    type: int
    description: ADC sequence oversampling factor.
    default: 4

  calibrate:
    type: boolean
    description: Run ADC calibration before the sequence.

  voltage-divider-r1:
    type: int
    description: Voltage divider numerator to scale ADC reading to actual voltage.
    default: 1

  voltage-divider-r2:
    type: int
    description: Voltage divider denominator to scale ADC reading to actual voltage.
    default: 1
```

## modules/move_controller/Kconfig
```kconfig
# Copyright (C) 2026 Georgi Danovski
#
# This program is free software: you can redistribute it and/or modify
# it under the terms of the GNU General Public License as published by
# the Free Software Foundation, either version 3 of the License, or
# (at your option) any later version.
#
# This program is distributed in the hope that it will be useful,
# but WITHOUT ANY WARRANTY; without even the implied warranty of
# MERCHANTABILITY or FITNESS FOR A PARTICULAR PURPOSE.  See the
# GNU General Public License for more details.
#
# You should have received a copy of the GNU General Public License
# along with this program.  If not, see <https://www.gnu.org/licenses/>.

menu "Move controller module"

config MOVE_CONTROLLER_MODULE
	bool "Enable move controller module"
	default y
	depends on QUADRUPED_MODULE

config MOVE_CONTROLLER_MODULE_LOG_LEVEL
	int "Move controller module log level"
	range 0 4
	default 3
	depends on MOVE_CONTROLLER_MODULE && LOG

endmenu
```

## modules/quadruped/Kconfig
```kconfig
# Copyright (C) 2026 Georgi Danovski
#
# This program is free software: you can redistribute it and/or modify
# it under the terms of the GNU General Public License as published by
# the Free Software Foundation, either version 3 of the License, or
# (at your option) any later version.
#
# This program is distributed in the hope that it will be useful,
# but WITHOUT ANY WARRANTY; without even the implied warranty of
# MERCHANTABILITY or FITNESS FOR A PARTICULAR PURPOSE.  See the
# GNU General Public License for more details.
#
# You should have received a copy of the GNU General Public License
# along with this program.  If not, see <https://www.gnu.org/licenses/>.

menu "Quadruped module"

config QUADRUPED_MODULE
	bool "Enable quadruped module"
	default y
	depends on LEG_MODULE
	help
	  Enable the quadruped controller module.

if QUADRUPED_MODULE

config QUADRUPED_MODULE_INIT_PRIORITY
	int "Quadruped device init priority"
	range 0 999
	default 90
	help
	  Initialization priority for the danovski,quadruped device at POST_KERNEL
	  level. Use a value higher than LEG_MODULE_INIT_PRIORITY to initialize after
	  all leg devices.

endif

endmenu
```

## modules/quadruped/dts/bindings/mfd/danovski,quadruped.yaml
```yaml
# Copyright (C) 2026 Georgi Danovski
#
# This program is free software: you can redistribute it and/or modify
# it under the terms of the GNU General Public License as published by
# the Free Software Foundation, either version 3 of the License, or
# (at your option) any later version.
#
# This program is distributed in the hope that it will be useful,
# but WITHOUT ANY WARRANTY; without even the implied warranty of
# MERCHANTABILITY or FITNESS FOR A PARTICULAR PURPOSE.  See the
# GNU General Public License for more details.
#
# You should have received a copy of the GNU General Public License
# along with this program.  If not, see <https://www.gnu.org/licenses/>.

description: Quadruped robot controller node with four leg child devices
compatible: "danovski,quadruped"

include: base.yaml

properties:
  leg-front-left:
    type: phandle
    required: true
    description: Phandle to the front-left leg device.

  leg-front-right:
    type: phandle
    required: true
    description: Phandle to the front-right leg device.

  leg-back-left:
    type: phandle
    required: true
    description: Phandle to the back-left leg device.

  leg-back-right:
    type: phandle
    required: true
    description: Phandle to the back-right leg device.
```

## modules/voltage_regulator/Kconfig
```kconfig
# Copyright (C) 2026 Georgi Danovski
#
# This program is free software: you can redistribute it and/or modify
# it under the terms of the GNU General Public License as published by
# the Free Software Foundation, either version 3 of the License, or
# (at your option) any later version.
#
# This program is distributed in the hope that it will be useful,
# but WITHOUT ANY WARRANTY; without even the implied warranty of
# MERCHANTABILITY or FITNESS FOR A PARTICULAR PURPOSE.  See the
# GNU General Public License for more details.
#
# You should have received a copy of the GNU General Public License
# along with this program.  If not, see <https://www.gnu.org/licenses/>.

menu "Voltage regulator module"

config VOLTAGE_REGULATOR_MODULE
	bool "Enable voltage regulator module"
	default y
	help
	  Enable the voltage regulator module. When enabled, programs the nRF UICR
	  REGOUT0 register to 3.3 V on startup.

endmenu
```
